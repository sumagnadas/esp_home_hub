## sdkconfig.defaults.example
```kconfig
CONFIG_IDF_TARGET="esp32s3" # Have run it on ESP32S3 N16R8

# credentials
CONFIG_ML_WIFI_SSID=<SSID for initial connecting wifi>
CONFIG_ML_WIFI_PASSWORD=<password for initial connecting wifi >
CONFIG_ML_TAILSCALE_AUTH_KEY=<Tailscale auth key>
CONFIG_ML_DEVICE_NAME="esp-home-hub"

# Partition table (app needs ~1MB+)
CONFIG_PARTITION_TABLE_SINGLE_APP_LARGE=y

# fixing mbedtls_chachapoly_* not being linked
CONFIG_MBEDTLS_CHACHA20_C=y
CONFIG_MBEDTLS_POLY1305_C=y
CONFIG_MBEDTLS_CHACHAPOLY_C=y

CONFIG_SPIRAM=y
CONFIG_SPIRAM_MODE_OCT=y
CONFIG_SPIRAM_TYPE_AUTO=y
CONFIG_SPIRAM_SPEED_80M=y
CONFIG_SPIRAM_ALLOW_STACK_EXTERNAL_MEMORY=y
CONFIG_SPIRAM_MALLOC_ALWAYSINTERNAL=4096
CONFIG_SPIRAM_MALLOC_RESERVE_INTERNAL=32768

# TLS/HTTPS (required for DERP and control plane)
CONFIG_ESP_TLS_USING_MBEDTLS=y
CONFIG_MBEDTLS_SSL_PROTO_TLS1_2=y
CONFIG_MBEDTLS_CERTIFICATE_BUNDLE=y
CONFIG_MBEDTLS_CERTIFICATE_BUNDLE_DEFAULT_CMN=y

# Networking
CONFIG_LWIP_IPV4=y
CONFIG_LWIP_IP4_FRAG=y
CONFIG_LWIP_IP4_REASSEMBLY=y

# Stack size
CONFIG_ESP_MAIN_TASK_STACK_SIZE=8192

# Enable HTTP server
CONFIG_ML_ENABLE_CONFIG_HTTPD=y

# fix not enough sockets 
CONFIG_LWIP_MAX_SOCKETS=20
```
